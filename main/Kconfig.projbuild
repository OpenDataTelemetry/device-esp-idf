## main/Kconfig.projbuild
```kconfig
menu "Application Configuration"


  # menu "IDF Configuration"
  #   choice IDF_TARGET
  #     prompt "Bootloader optimization Level"
  #     default IDF_TARGET_ESP32
  #     help
  #         If  
  #     config IDF_TARGET_ESP32
  #         bool "IDF_TARGET_ESP32"
  #     config IDF_TARGET_ESP32S3
  #         bool "IDF_TARGET_ESP32S3"
  #       config IDF_TARGET_ESP32C6
  #         bool "IDF_TARGET_ESP32C6"
  #   endchoice
  # endmenu


  menu "MQTT Configuration"

    config MQTT_BROKER_URL
        string "MQTT Broker URL"
        default "mqtt://mqtt.maua.br"
        help
            URL of the broker to connect to
  endmenu

  menu "TWAI Configuration"
    config TWAI_TX_GPIO_NUM
      int "TWAI TX GPIO number"
      default 21 if IDF_TARGET_ESP32
      default 1 if IDF_TARGET_ESP32S3
      default 4 if IDF_TARGET_ESP32C6
      default 21
      help
        This option selects the GPIO pin used for the TX signal. Connect the
        TX signal to your transceiver.

    config TWAI_RX_GPIO_NUM
      int "TWAI RX GPIO number"
      default 22 if IDF_TARGET_ESP32
      default 21 if IDF_TARGET_ESP32S3
      default 9 if IDF_TARGET_ESP32C6
      default 22
      help
        This option selects the GPIO pin used for the RX signal. Connect the
        RX signal to your transceiver.
  endmenu

  menu "UART_1 Configuration"
    config UART_1_TX_GPIO_NUM
      int "UART_1 TX GPIO number"
      default 12 if IDF_TARGET_ESP32
      default 18 if IDF_TARGET_ESP32S3
      default 14 if IDF_TARGET_ESP32C6
      default 12
      help
        This option selects the GPIO pin used for the TX signal. Connect the
        TX signal to your transceiver.

    config UART_1_RX_GPIO_NUM
      int "UART_1 RX GPIO number"
      default 14 if IDF_TARGET_ESP32
      default 17 if IDF_TARGET_ESP32S3
      default 15 if IDF_TARGET_ESP32C6
      default 14
      help
        This option selects the GPIO pin used for the RX signal. Connect the
        RX signal to your transceiver.
  endmenu

  menu "UART_2 Configuration"
    config UART_2_TX_GPIO_NUM
      int "UART_2 TX GPIO number"
      default 16 if IDF_TARGET_ESP32
      default 33 if IDF_TARGET_ESP32S3
      default 2 if IDF_TARGET_ESP32C6
      default 16
      help
        This option selects the GPIO pin used for the TX signal. Connect the
        TX signal to your transceiver.

    config UART_2_RX_GPIO_NUM
      int "UART_2 RX GPIO number"
      default 17 if IDF_TARGET_ESP32
      default 45 if IDF_TARGET_ESP32S3
      default 3 if IDF_TARGET_ESP32C6
      default 17
      help
        This option selects the GPIO pin used for the RX signal. Connect the
        RX signal to your transceiver.
  endmenu

  menu "I2C Configuration"
    config I2C_SCL_GPIO_NUM
      int "I2C SCL GPIO number"
      default 2 if IDF_TARGET_ESP32
      default 0 if IDF_TARGET_ESP32C6
      default 2
      help
        This option selects the GPIO pin used for the TX signal. Connect the
        TX signal to your transceiver.

    config I2C_SDA_GPIO_NUM
      int "I2C SDA GPIO number"
      default 4 if IDF_TARGET_ESP32
      default 1 if IDF_TARGET_ESP32C6
      default 4
      help
        This option selects the GPIO pin used for the RX signal. Connect the
        RX signal to your transceiver.
  endmenu

  # nmea
  menu "NMEA Modem"
    orsource "$IDF_PATH/examples/common_components/env_caps/$IDF_TARGET/Kconfig.env_caps"

    

    config NMEA_PARSER_UART_BAUD_RATE
      int "NMEA UART Baud Rater"
      default 115200
      help
        BaudRate for UART. See UART documentation for more information
        about available pin numbers for UART.


    config NMEA_PARSER_UART_TXD
      int "NMEA UART TXD pin number"
      range ENV_GPIO_RANGE_MIN ENV_GPIO_IN_RANGE_MAX
      default 18
      help
        GPIO number for UART RX pin. See UART documentation for more information
        about available pin numbers for UART.

    config NMEA_PARSER_UART_RXD
      int "NMEA UART RXD pin number"
      range ENV_GPIO_RANGE_MIN ENV_GPIO_IN_RANGE_MAX
      default 17
      help
        GPIO number for UART RX pin. See UART documentation for more information
        about available pin numbers for UART.

    config NMEA_PARSER_RING_BUFFER_SIZE
      int "NMEA Parser Ring Buffer Size"
      range 0 2048
      default 1024
      help
        Size of the ring buffer used for UART Rx channel.

    config NMEA_PARSER_TASK_STACK_SIZE
      int "NMEA Parser Task Stack Size"
      range 0 4096
      default 3072
      help
        Stack size of NMEA Parser task.

    config NMEA_PARSER_TASK_PRIORITY
      int "NMEA Parser Task Priority"
      range 0 24
      default 2
      help
        Priority of NMEA Parser task.

    menu "NMEA Statement Support"
      comment "At least one statement must be selected"
      config NMEA_STATEMENT_GGA
        bool "GGA Statement"
        default y
        help
          Enabling this option will parse the following parameter from GGA statement:

          - Latitude, Longitude, Altitude;
          - Number of satellites in use, fix status (no fix, GPS, DGPS), UTC time;

      config NMEA_STATEMENT_GSA
        bool "GSA Statement"
        default y
        help
          Enabling this option will parse the following parameter from GSA statement:

          - Position/Vertical/Horizontal dilution of precision;
          - Fix mode (no fix, 2D, 3D fix);
          - IDs of satellites in use;

      config NMEA_STATEMENT_GSV
        bool "GSV Statement"
        default y
        help
          Enabling this option will parse the following parameter from GSV statement:

          - Number of satellites in view;
          - Optional details of each satellite in view;

      config NMEA_STATEMENT_RMC
        bool "RMC Statement"
        default y
        help
          Enabling this option will parse the following parameter from RMC statement:

          - Validity of GPS signal;
          - Ground speed (knots) and course over ground (degrees);
          - Magnetic variation;
          - UTC date;

      config NMEA_STATEMENT_GLL
        bool "GLL Statement"
        default y
        help
          Enabling this option will parse the following parameter from GLL statement:

          - Latitude, Longitude;
          - UTC time;

      config NMEA_STATEMENT_VTG
        bool "VTG Statement"
        default y
        help
          Enabling this option will parse the following parameter from VTG statement:

          - Ground speed (knots, km/h) and course over ground (degrees);
          - Magnetic variation;
    endmenu
  endmenu
endmenu
```
